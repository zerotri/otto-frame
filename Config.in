## Config.in
```kconfig
menu "Stak"
	depends on BR2_arm

	config BR2_PACKAGE_META_OTTO
	bool "otto-full-stack"
	depends on BR2_arm
	select BR2_PACKAGE_CREATE_AP
	select BR2_PACKAGE_OTTOUPDATE
	select BR2_PACKAGE_PYTHON
	select BR2_PACKAGE_PYTHON_BOTTLE
	help
	  Full software stack for OTTO camera

	source "$BR2_EXTERNAL/packages/ottosdk/Config.in"

	menu "Libraries"
		source "$BR2_EXTERNAL/packages/platform/generic/OttDate/Config.in"
		source "$BR2_EXTERNAL/packages/platform/generic/fwup/Config.in"
		source "$BR2_EXTERNAL/packages/platform/generic/fwup/Config.in.host"
		source "$BR2_EXTERNAL/packages/platform/raspberrypi/libbcm2835/Config.in"
		source "$BR2_EXTERNAL/packages/platform/raspberrypi/armmem/Config.in"
		source "$BR2_EXTERNAL/packages/platform/raspberrypi/gifsicle/Config.in"
		source "$BR2_EXTERNAL/packages/platform/raspberrypi/rpi-userland/Config.in"
		source "$BR2_EXTERNAL/packages/platform/raspberrypi/dcfldd/Config.in"
		source "$BR2_EXTERNAL/packages/platform/raspberrypi/otto-fastcamd/Config.in"
		source "$BR2_EXTERNAL/packages/platform/raspberrypi/otto-boot/Config.in"
		source "$BR2_EXTERNAL/packages/platform/raspberrypi/otto-wifi/Config.in"
		source "$BR2_EXTERNAL/packages/platform/raspberrypi/otto-logo/Config.in"
		source "$BR2_EXTERNAL/packages/platform/raspberrypi/otto-shutdown/Config.in"
		source "$BR2_EXTERNAL/packages/platform/raspberrypi/otto-hostname/Config.in"
		source "$BR2_EXTERNAL/packages/platform/raspberrypi/ottoupdate/Config.in"
		source "$BR2_EXTERNAL/packages/platform/raspberrypi/otto-gfx/Config.in"
		source "$BR2_EXTERNAL/packages/platform/raspberrypi/otto-runner/Config.in"
		source "$BR2_EXTERNAL/packages/platform/raspberrypi/otto-menu/Config.in"
		source "$BR2_EXTERNAL/packages/platform/raspberrypi/otto-network-setup/Config.in"
		source "$BR2_EXTERNAL/packages/platform/raspberrypi/otto-gif-mode/Config.in"
		source "$BR2_EXTERNAL/packages/platform/raspberrypi/libOttoHardware/Config.in"
		source "$BR2_EXTERNAL/packages/platform/raspberrypi/nanosvg/Config.in"
		source "$BR2_EXTERNAL/packages/platform/raspberrypi/create_ap/Config.in"
		source "$BR2_EXTERNAL/packages/platform/rtl81xx/Config.in"
	endmenu
endmenu
```

## configs/otto_defconfig
```kconfig
BR2_arm=y
BR2_arm1176jzf_s=y
BR2_ARM_EABIHF=y
BR2_STRIP_EXCLUDE_FILES="/usr/bin/otto-runner /stak/sdk/libotto_gif_mode.so /stak/sdk/libotto_menu.so"
BR2_SHARED_STATIC_LIBS=y
BR2_KERNEL_HEADERS_3_18=y
BR2_TOOLCHAIN_BUILDROOT_GLIBC=y
BR2_BINUTILS_VERSION_2_25_X=y
BR2_EXTRA_GCC_CONFIG_OPTIONS="--with-arch=armv6 --with-cpu=arm1176jzf-s --with-float=hard"
BR2_TOOLCHAIN_BUILDROOT_CXX=y
BR2_PACKAGE_HOST_GDB=y
BR2_TARGET_GENERIC_HOSTNAME="stak"
BR2_TARGET_GENERIC_ISSUE="Welcome to Stak"
BR2_INIT_SYSTEMD=y
BR2_SYSTEM_BIN_SH_BASH=y
BR2_TARGET_GENERIC_GETTY_PORT="ttyAMA0"
BR2_ROOTFS_POST_BUILD_SCRIPT="${BR2_EXTERNAL}/board/stak/customize_rootfs.sh"
BR2_ROOTFS_POST_IMAGE_SCRIPT="${BR2_EXTERNAL}/board/stak/post_build.sh"
BR2_LINUX_KERNEL=y
BR2_LINUX_KERNEL_CUSTOM_GIT=y
BR2_LINUX_KERNEL_CUSTOM_REPO_URL="git://github.com/raspberrypi/linux.git"
BR2_LINUX_KERNEL_CUSTOM_REPO_VERSION="8362c08dfc8dd9e54745b3f1e5e4ff0a1fb30614"
BR2_LINUX_KERNEL_PATCH="rtl8192cu-HACKY-addition-of-cfg80211-interface-suppo.patch"
BR2_LINUX_KERNEL_USE_CUSTOM_CONFIG=y
BR2_LINUX_KERNEL_CUSTOM_CONFIG_FILE="${BR2_EXTERNAL}/board/stak/stak-linux-defconfig"
BR2_LINUX_KERNEL_ZIMAGE=y
BR2_PACKAGE_GDB=y
BR2_PACKAGE_GDB_DEBUGGER=y
BR2_PACKAGE_BINUTILS=y
BR2_PACKAGE_E2FSPROGS=y
BR2_PACKAGE_RPI_FIRMWARE=y
BR2_PACKAGE_RPI_FIRMWARE_X=y
BR2_PACKAGE_DBUS_CPP=y
BR2_PACKAGE_DBUS_PYTHON=y
BR2_PACKAGE_I2C_TOOLS=y
BR2_PACKAGE_PYTHON=y
BR2_PACKAGE_PYTHON_BOTTLE=y
BR2_PACKAGE_JPEG=y
BR2_PACKAGE_JPEG_TURBO=y
BR2_PACKAGE_GLM=y
BR2_PACKAGE_LIBUV=y
BR2_PACKAGE_LINUX_PAM=y
BR2_PACKAGE_POPT=y
BR2_PACKAGE_AVAHI=y
BR2_PACKAGE_AVAHI_DAEMON=y
BR2_PACKAGE_AVAHI_LIBDNSSD_COMPATIBILITY=y
BR2_PACKAGE_BRIDGE_UTILS=y
BR2_PACKAGE_CONNMAN=y
BR2_PACKAGE_CONNMAN_WIFI=y
BR2_PACKAGE_CONNMAN_WISPR=y
BR2_PACKAGE_CONNMAN_DEBUG=y
BR2_PACKAGE_CONNMAN_CLIENT=y
BR2_PACKAGE_DHCPCD=y
BR2_PACKAGE_DNSMASQ=y
BR2_PACKAGE_HOSTAPD=y
BR2_PACKAGE_IPROUTE2=y
BR2_PACKAGE_IW=y
BR2_PACKAGE_OPENSSH=y
BR2_PACKAGE_WIRELESS_TOOLS=y
BR2_PACKAGE_WIRELESS_TOOLS_LIB=y
BR2_PACKAGE_WPA_SUPPLICANT_AP_SUPPORT=y
BR2_PACKAGE_WPA_SUPPLICANT_CLI=y
BR2_PACKAGE_WPA_SUPPLICANT_DBUS_INTROSPECTION=y
BR2_PACKAGE_ZSH=y
BR2_PACKAGE_SYSTEMD_ALL_EXTRAS=y
BR2_PACKAGE_SYSTEMD_JOURNAL_GATEWAY=y
BR2_PACKAGE_OTTDATE=y
BR2_PACKAGE_FWUP=y
BR2_PACKAGE_HOST_FWUP=y
BR2_PACKAGE_LIBBCM2835=y
BR2_PACKAGE_GIFSICLE=y
BR2_PACKAGE_OTTO_FASTCAMD=y
BR2_PACKAGE_OTTO_BOOT=y
BR2_PACKAGE_OTTO_WIFI=y
BR2_PACKAGE_OTTO_SHUTDOWN=y
BR2_PACKAGE_OTTO_HOSTNAME=y
BR2_PACKAGE_OTTO_GFX=y
BR2_PACKAGE_OTTO_MENU=y
BR2_PACKAGE_OTTO_NETWORK_SETUP=y
BR2_PACKAGE_OTTO_GIF_MODE=y
BR2_PACKAGE_LIBOTTOHARDWARE=y
BR2_PACKAGE_NANOSVG=y
BR2_TARGET_ROOTFS_EXT2=y
BR2_TARGET_ROOTFS_EXT2_4=y
BR2_TARGET_ROOTFS_EXT2_BLOCKS=262144
```

## packages/ottosdk/Config.in
```kconfig
config BR2_PACKAGE_OTTOSDK
	bool "ottosdk"
	depends on BR2_arm
	select BR2_PACKAGE_JPEG
	select BR2_PACKAGE_LIBBCM2835
	select BR2_PACKAGE_RPI_USERLAND
	select BR2_PACKAGE_GIFSICLE
	select BR2_PACKAGE_PYTHON
	select BR2_PACKAGE_PYTHON_UNICODEDATA
	help
	  Hardware Test For Stak
```

## packages/platform/generic/OttDate/Config.in
```kconfig
config BR2_PACKAGE_OTTDATE
        bool "OttDate"
        help
          The Otto Updater

          http://github.com/NextThingCo/OttDate
```

## packages/platform/raspberrypi/armmem/Config.in
```kconfig
config BR2_PACKAGE_ARMMEM
	bool "armmem"
	depends on BR2_arm
	help
	  Hardware Interface library for the BCM2835 chip.

	  http://www.airspayce.com/mikem/bcm2835/
```

## packages/platform/raspberrypi/bgfx/Config.in
```kconfig
config BR2_PACKAGE_BGFX
	bool "bgfx"
	depends on BR2_PACKAGE_BX
	help
	  Cross-platform rendering library.

	  https://github.com/bkaradzic/bgfx
```

## packages/platform/raspberrypi/bx/Config.in
```kconfig
config BR2_PACKAGE_BX
	bool "bx"
	depends on BR2_arm
	help
	  Cross-platform rendering library.

	  https://github.com/bkaradzic/bx
```

## packages/platform/raspberrypi/create_ap/Config.in
```kconfig
config BR2_PACKAGE_CREATE_AP
	bool "create_ap"
	depends on BR2_arm
	select BR2_PACKAGE_BRIDGE_UTILS
	select BR2_PACKAGE_DHCPCD
	select BR2_PACKAGE_DNSMASQ
	select BR2_PACKAGE_HOSTAPD
	select BR2_PACKAGE_IPROUTE2
	select BR2_PACKAGE_IPTABLES
	select BR2_PACKAGE_IW
	select BR2_PACKAGE_WIRELESS_TOOLS
	select BR2_PACKAGE_WPA_SUPPLICANT
	help
	  Hardware Interface library for the BCM2835 chip.

	  http://www.airspayce.com/mikem/bcm2835/
```

## packages/platform/raspberrypi/dcfldd/Config.in
```kconfig
config BR2_PACKAGE_DCFLDD
	bool "dcfldd"
	depends on BR2_arm
	help
	  Hardware Interface library for the BCM2835 chip.

	  http://www.airspayce.com/mikem/bcm2835/
```

## packages/platform/raspberrypi/gifsicle/Config.in
```kconfig
config BR2_PACKAGE_GIFSICLE
	bool "gifsicle"
	depends on BR2_arm
	help
	  Hardware Interface library for the BCM2835 chip.

	  http://www.airspayce.com/mikem/bcm2835/
```

## packages/platform/raspberrypi/otto-boot/Config.in
```kconfig
config BR2_PACKAGE_OTTO_BOOT
	bool "otto-boot"
	depends on BR2_arm
  depends on BR2_PACKAGE_LIBOTTOHARDWARE
	help
	  Hardware Interface library for the BCM2835 chip.

	  http://www.airspayce.com/mikem/bcm2835/
```

## packages/platform/raspberrypi/otto-fastcamd/Config.in
```kconfig
config BR2_PACKAGE_OTTO_FASTCAMD
	bool "otto-fastcamd"
	depends on BR2_arm
	help
	  Hardware Interface library for the BCM2835 chip.

	  http://www.airspayce.com/mikem/bcm2835/
```

## packages/platform/raspberrypi/otto-gfx/Config.in
```kconfig
config BR2_PACKAGE_OTTO_GFX
	bool "otto-gfx"
	depends on BR2_arm
	help
	  Hardware Interface library for the BCM2835 chip.

	  http://www.airspayce.com/mikem/bcm2835/
```

## packages/platform/raspberrypi/otto-logo/Config.in
```kconfig
config BR2_PACKAGE_OTTO_LOGO
	bool "otto-logo"
	depends on BR2_arm
  depends on BR2_PACKAGE_RPI_USERLAND
	help
	  Hardware Interface library for the BCM2835 chip.

	  http://www.airspayce.com/mikem/bcm2835/
```

## packages/platform/raspberrypi/otto-menu/Config.in
```kconfig
config BR2_PACKAGE_OTTO_MENU
	bool "otto-menu"
	depends on BR2_arm
	depends on BR2_PACKAGE_OTTDATE
	help
	  The Otto Menu 

	  http://www.nextthing.co
```

## packages/platform/raspberrypi/otto-network-setup/Config.in
```kconfig
config BR2_PACKAGE_OTTO_NETWORK_SETUP
	bool "otto-network-setup"
  help
    The webserver that allows to setup Otto's network
    http://github.com/NextThingCo/otto-network-setup
	depends on BR2_arm
  depends on BR2_PACKAGE_HOSTAPD
  depends on BR2_PACKAGE_DNSMASQ
  depends on BR2_PACKAGE_CONNMAN
```

## packages/platform/raspberrypi/otto-runner/Config.in
```kconfig
config BR2_PACKAGE_OTTO_RUNNER
	bool "otto-runner"
	depends on BR2_arm
  depends on BR2_PACKAGE_LIBOTTOHARDWARE
  depends on BR2_PACKAGE_RPI_USERLAND
	help
	  Hardware Interface library for the BCM2835 chip.

	  http://www.airspayce.com/mikem/bcm2835/
```

## packages/platform/raspberrypi/otto-shutdown/Config.in
```kconfig
config BR2_PACKAGE_OTTO_SHUTDOWN
	bool "otto-shutdown"
	depends on BR2_arm
	help
	  Hardware Interface library for the BCM2835 chip.

	  http://www.airspayce.com/mikem/bcm2835/
```

## packages/platform/raspberrypi/otto-wifi/Config.in
```kconfig
config BR2_PACKAGE_OTTO_WIFI
	bool "otto-wifi"
	depends on BR2_arm
  depends on BR2_PACKAGE_HOSTAPD
  depends on BR2_PACKAGE_DNSMASQ
  depends on BR2_PACKAGE_CONNMAN
```

## packages/platform/raspberrypi/ottoupdate/Config.in
```kconfig
config BR2_PACKAGE_OTTOUPDATE
	bool "ottoupdate"
	depends on BR2_arm
	select BR2_PACKAGE_DCFLDD
	select BR2_PACKAGE_PYTHON
	select BR2_TARGET_ROOTFS_EXT2
	select BR2_TARGET_ROOTFS_EXT2_4
	help
	  Hardware Interface library for the BCM2835 chip.

	  http://www.airspayce.com/mikem/bcm2835/
```

## packages/platform/rtl81xx/Config.in
```kconfig
config BR2_PACKAGE_RTL81XX
	bool "rtl81xx"
	depends on BR2_arm
	help
	  Hardware Interface library for the BCM2835 chip.

	  http://www.airspayce.com/mikem/bcm2835/
```
